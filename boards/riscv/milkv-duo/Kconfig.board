## boards/riscv/milkv-duo/Kconfig.board
```kconfig
# Copyright (c) 2024 GP Orcullo
# SPDX-License-Identifier: Apache-2.0

config BOARD_MILKV_DUO
	bool "Sophgo Milk-V Duo"
```

## boards/riscv/milkv-duo/Kconfig.defconfig
```kconfig
# Copyright (c) 2024 GP Orcullo
# SPDX-License-Identifier: Apache-2.0

config BOARD
	default "milkv_duo"
    depends on BOARD_MILKV_DUO
```

## boards/riscv/milkv-duo/milkv_duo_defconfig
```kconfig
# Copyright (c) 2024 GP Orcullo
# SPDX-License-Identifier: Apache-2.0

CONFIG_BOARD_MILKV_DUO=y
CONFIG_SOC_SERIES_SOPHGO=y
# CONFIG_XIP is not set

CONFIG_CONSOLE=y
CONFIG_SERIAL=y
CONFIG_UART_CONSOLE=y
CONFIG_STACK_SENTINEL=y
```

## drivers/Kconfig
```kconfig
# Copyright (c) 2024 GP Orcullo
# SPDX-License-Identifier: Apache-2.0

menu "Drivers"
rsource "timer/Kconfig"
rsource "ipm/Kconfig"
endmenu
```

## drivers/ipm/Kconfig
```kconfig
# SPDX-License-Identifier: Apache-2.0

if IPM

config SOPHGO_CV180X_IPM
	bool "Sophgo CV180X IPM driver"
	default y
	depends on DT_HAS_SOPHGO_CV180X_IPM_ENABLED
	help
	  Interprocessor mailbox  driver for Sophgo CV180x.

endif #IPM
```

## drivers/timer/Kconfig
```kconfig
# Copyright (c) 2024 GP Orcullo
# SPDX-License-Identifier: Apache-2.0

config SOPHGO_CV1800B_CLINT
	bool "Sophgo CV1800B Machine Timer"
	default y
	depends on DT_HAS_SOPHGO_CV1800B_CLINT_ENABLED
	select TICKLESS_CAPABLE
	select TIMER_HAS_64BIT_CYCLE_COUNTER

if SOPHGO_CV1800B_CLINT

config RISCV_MACHINE_TIMER_SYSTEM_CLOCK_DIVIDER
    default 0

endif
```

## dts/bindings/sophgo,cv1800b-clint.yaml
```yaml
# Copyright (c) 2024 GP Orcullo
# SPDX-License-Identifier: Apache-2.0

description: Sophgo CV1800B RISC-V Core-Local Interruptor.

compatible: "sophgo,cv1800b-clint"

include: sifive,clint0.yaml

properties:
  use-csr:
    type: boolean
    description: Use CSR to access timer value.

  use-32bit:
    type: boolean
    description: Use multiword to access registers.
```

## dts/bindings/sophgo,cv180x-ipm.yaml
```yaml
# SPDX-License-Identifier: Apache-2.0

description: Sophgo CV180x IPM

compatible: "sophgo,cv180x-ipm"

include: base.yaml

properties:
  reg:
    required: true

  interrupts:
    required: true

  interrupt-parent:
    required: true
```

## manifest-repo/west.yml
```yaml
manifest:
  remotes:
    - name: zephyrproject-rtos
      url-base: https://github.com/zephyrproject-rtos
  projects:
    - name: zephyr
      remote: zephyrproject-rtos
      revision: v3.6.0
      import:
        name-allowlist:
          - open-amp
          - libmetal
  self:
    path: manifest-repo
```

## soc/riscv/sophgo/Kconfig
```kconfig
# Copyright (c) 2024 GP Orcullo
# SPDX-License-Identifier: Apache-2.0

config SOC_FAMILY_SOPHGO
	bool

if SOC_FAMILY_SOPHGO

config SOC_FAMILY
	string
	default "sophgo"

rsource "*/Kconfig.soc"

endif # SOC_FAMILY_SOPHGO
```

## soc/riscv/sophgo/Kconfig.soc
```kconfig
# Copyright (c) 2024 GP Orcullo
# SPDX-License-Identifier: Apache-2.0

rsource "*/Kconfig.series"
```

## soc/riscv/sophgo/cv1800b/Kconfig.defconfig.series
```kconfig
# Copyright (c) 2024 GP Orcullo
# SPDX-License-Identifier: Apache-2.0

if SOC_SERIES_SOPHGO

config SOC_SERIES
	default "cv1800b"

config SYS_CLOCK_HW_CYCLES_PER_SEC
	default 25000000

config RISCV_SOC_INTERRUPT_INIT
	default y

config RISCV_GP
	default n

config NUM_IRQS
	default 64

endif
```

## soc/riscv/sophgo/cv1800b/Kconfig.series
```kconfig
# Copyright (c) 2024 GP Orcullo
# SPDX-License-Identifier: Apache-2.0

config SOC_SERIES_SOPHGO
	bool "Sophgo SoCs"
	select 64BIT
	select RISCV
	select RISCV_PRIVILEGED
    select RISCV_HAS_PLIC
	select SOC_FAMILY_SOPHGO
	help
	  Enable support for Sophgo SoCs
```

## soc/riscv/sophgo/cv1800b/Kconfig.soc
```kconfig
# Copyright (c) 2024 GP Orcullo
# SPDX-License-Identifier: Apache-2.0

choice
	prompt "Sophgo SoCs"
	depends on SOC_SERIES_SOPHGO

config SOC_CV1800B_LITTLE
	bool "CV1800b secondary processor"
	select ATOMIC_OPERATIONS_BUILTIN
	select CPU_HAS_FPU_DOUBLE_PRECISION
	select INCLUDE_RESET_VECTOR
	select RISCV_ISA_RV64I
	select RISCV_ISA_EXT_M
	select RISCV_ISA_EXT_A
	select RISCV_ISA_EXT_C
	select RISCV_ISA_EXT_ZICSR
	select RISCV_ISA_EXT_ZIFENCEI

endchoice
```
